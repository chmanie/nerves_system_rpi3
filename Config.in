## Config.in
```kconfig
# Add project-specific packages for Buildroot here
#
# If these are non-proprietary, please consider contributing them back to
# Nerves or Buildroot.

source "$NERVES_DEFCONFIG_DIR/package/gphoto2/Config.in"
source "$NERVES_DEFCONFIG_DIR/package/libgphoto2a/Config.in"
```

## package/gphoto2/Config.in
```kconfig
config BR2_PACKAGE_GPHOTO2
  bool "gphoto2"
  select BR2_PACKAGE_LIBGPHOTO2A
  select BR2_PACKAGE_POPT
  help
    gphoto2 can steer and connect to DSLR cameras via USB

    http://gphoto.sourceforge.net/
```

## package/libgphoto2a/Config.in
```kconfig
config BR2_PACKAGE_LIBGPHOTO2A
  bool "libgphoto2a"
  depends on BR2_TOOLCHAIN_HAS_THREADS # libusb
  select BR2_PACKAGE_LIBTOOL
  select BR2_PACKAGE_LIBUSB
  select BR2_PACKAGE_LIBXML2
  help
    libgphoto2 is the core library designed to allow access to
    digital camera by external programs.

    http://gphoto.org/proj/libgphoto2/

comment "libgphoto needs a toolchain w/ threads"
  depends on !BR2_TOOLCHAIN_HAS_THREADS
```
